// SPDX-License-Identifier: GPL-2.0-only
/*
 * Device Tree overlay for Pamir AI SAM Module on Rockchip RK3576
 * Compatible with ArmSom CM5 IO and other RK3576-based boards
 *
 * Copyright (C) 2025 PamirAI Incorporated.
 */

/dts-v1/;
/plugin/;

/ {
	metadata {
		title = "Enable PamirAI SAM Module";
		compatible = "armsom,cm5-io", "rockchip,rk3576";
		category = "misc";
		exclusive = "GPIO4_B4", "GPIO4_B5", "UART2_M1";
		description = "Enables the PamirAI SAM Module connected via UART2 M1 (pins 3/5)";
	};
};


&uart2 {
	status = "okay";
	pinctrl-names = "default";
	pinctrl-0 = <&uart2m1_xfer>;

	pamir_ai_sam: pamir-ai-sam {
		compatible = "pamir-ai,sam";
		status = "okay";
		num-leds = <6>;  /* Number of physical RGB LEDs on hardware */
		debug-level = <0>;  /* no debug output */
		recovery-timeout-ms = <1000>;
		power-poll-interval-ms = <1000>; /* 0 means no polling */
		/* ack-required; // Disabled to prevent ping spam */
	};
};
